## drivers/acpi/numa/Kconfig
```kconfig
# SPDX-License-Identifier: GPL-2.0
config ACPI_NUMA
	def_bool NUMA && !X86

config ACPI_HMAT
	bool "ACPI Heterogeneous Memory Attribute Table Support"
	depends on ACPI_NUMA
	select HMEM_REPORTING
	select MEMREGION
	help
	 If set, this option has the kernel parse and report the
	 platform's ACPI HMAT (Heterogeneous Memory Attributes Table),
	 register memory initiators with their targets, and export
	 performance attributes through the node's sysfs device if
	 provided.

config ACPI_NUMA_STANDBY_NODES
	int "Standby NUMA nodes per CPU node for runtime claiming"
	depends on ACPI_NUMA
	range 0 16
	default 0
	help
	  Number of standby NUMA nodes to reserve per CPU node at boot
	  for runtime claiming via numa_request_exclusive_node().

	  If set to N, and the SRAT describes C nodes with CPU
	  affinity entries, then N*C empty standby nodes are reserved
	  at boot.

	  These nodes have no memory and no SRAT PXM association.
	  Drivers (CXL, GPU, virtio-mem, etc.) can claim them to place
	  hotplugged memory on distinct NUMA nodes for memory tiering
	  or isolation purposes.

	  Set to 0 (default) to disable.
```

## drivers/cram/Kconfig
```kconfig
# SPDX-License-Identifier: GPL-2.0
config CRAM
	tristate "Compressed-RAM private-node read-only tier"
	depends on NUMA && MIGRATION && MMU && MEMORY_HOTPLUG
	select BALLOON
	help
	  Manage folios demoted onto private memory nodes (e.g. compressed
	  CXL memory) as a read-only tier.  Folios are diverted onto a CRAM
	  private node during reclaim and mapped present read-only so reads
	  are zero-copy; write faults promote the folio back to DRAM.  Entry
	  is by migration (no swap dependency).

	  A device driver registers its memory with cram_register(); the
	  write fence itself is core mm and needs nothing from here.

	  If unsure, say N.
```

## drivers/cxl/type3_drivers/Kconfig
```kconfig
# SPDX-License-Identifier: GPL-2.0
source "drivers/cxl/type3_drivers/cxl_mempolicy/Kconfig"
```

## drivers/cxl/type3_drivers/cxl_compression/Kconfig
```kconfig
config CXL_COMPRESSION
	tristate "CXL Compression Memory Driver"
	depends on CXL_PCI
	depends on CXL_REGION
	depends on CRAM
	help
	  This driver provides an alternative PCI binding for CXL memory
	  devices with compressed memory support. It converts CXL RAM
	  regions to sysram for direct memory hotplug and registers with
	  the CRAM subsystem for transparent compression.

	  Page reclamation uses the standard CXL Media Operations Zero
	  command (opcode 0x4402). If the device does not support it,
	  the driver falls back to inline CPU zeroing.

	  Usage: First unbind the device from cxl_pci, then bind to
	  cxl_compression. The driver will initialize the CXL device and
	  convert any RAM regions to use direct memory hotplug via sysram.

	  If unsure say 'n'.
```

## drivers/cxl/type3_drivers/cxl_mempolicy/Kconfig
```kconfig
config CXL_MEMPOLICY
	tristate "CXL Private Memory with Mempolicy Support"
	depends on CXL_PCI
	depends on CXL_REGION
	depends on NUMA
	depends on MIGRATION
	help
	  Minimal driver for CXL memory devices that registers memory as a
	  private node with mempolicy support.  The memory is isolated
	  from default allocations and can only be reached via explicit
	  mempolicy (set_mempolicy or mbind).

	  No compression, no PTE controls, the memory behaves like normal
	  DRAM but is excluded from fallback allocations.

	  If unsure say 'n'.
```

## drivers/dax/Kconfig
```kconfig
# SPDX-License-Identifier: GPL-2.0-only
menuconfig DAX
	tristate "DAX: direct access to differentiated memory"
	default m if NVDIMM_DAX

if DAX

config DEV_DAX
	tristate "Device DAX: direct access mapping device"
	depends on TRANSPARENT_HUGEPAGE
	help
	  Support raw access to differentiated (persistence, bandwidth,
	  latency...) memory via an mmap(2) capable character
	  device.  Platform firmware or a device driver may identify a
	  platform memory resource that is differentiated from the
	  baseline memory pool.  Mappings of a /dev/daxX.Y device impose
	  restrictions that make the mapping behavior deterministic.

config DEV_DAX_PMEM
	tristate "PMEM DAX: direct access to persistent memory"
	depends on LIBNVDIMM && NVDIMM_DAX && DEV_DAX
	default DEV_DAX
	help
	  Support raw access to persistent memory.  Note that this
	  driver consumes memory ranges allocated and exported by the
	  libnvdimm sub-system.

	  Say M if unsure

config DEV_DAX_HMEM
	tristate "HMEM DAX: direct access to 'specific purpose' memory"
	depends on EFI_SOFT_RESERVE
	select NUMA_KEEP_MEMINFO if NUMA_MEMBLKS
	default DEV_DAX
	depends on CXL_ACPI || !CXL_ACPI
	depends on CXL_PCI || !CXL_PCI
	depends on CXL_BUS || !CXL_BUS
	help
	  EFI 2.8 platforms, and others, may advertise 'specific purpose'
	  memory. For example, a high bandwidth memory pool. The
	  indication from platform firmware is meant to reserve the
	  memory from typical usage by default. This driver creates
	  device-dax instances for these memory ranges, and that also
	  enables the possibility to assign them to the DEV_DAX_KMEM
	  driver to override the reservation and add them to kernel
	  "System RAM" pool.

	  Say M if unsure.

config DEV_DAX_CXL
	tristate "CXL DAX: direct access to CXL RAM regions"
	depends on CXL_BUS && CXL_REGION && DEV_DAX
	default CXL_REGION && DEV_DAX
	depends on DEV_DAX_HMEM || !DEV_DAX_HMEM
	help
	  CXL RAM regions are either mapped by platform-firmware
	  and published in the initial system-memory map as "System RAM", mapped
	  by platform-firmware as "Soft Reserved", or dynamically provisioned
	  after boot by the CXL driver. In the latter two cases a device-dax
	  instance is created to access that unmapped-by-default address range.
	  Per usual it can remain as dedicated access via a device interface, or
	  converted to "System RAM" via the dax_kmem facility.

config DEV_DAX_HMEM_DEVICES
	depends on DEV_DAX_HMEM && DAX
	def_bool y

config DEV_DAX_FSDEV
	tristate
	depends on DEV_DAX && FS_DAX
	default DEV_DAX

config DEV_DAX_KMEM
	tristate "KMEM DAX: map dax-devices as System-RAM"
	default DEV_DAX
	depends on DEV_DAX
	depends on MEMORY_HOTPLUG # for add_memory() and friends
	help
	  Support access to persistent, or other performance
	  differentiated memory as if it were System RAM. This allows
	  easier use of persistent memory by unmodified applications, or
	  adds core kernel memory services to heterogeneous memory types
	  (HMEM) marked "reserved" by platform firmware.

	  To use this feature, a DAX device must be unbound from the
	  device_dax driver and bound to this kmem driver on each boot.

	  Say N if unsure.

config DEV_DAX_ANON
	tristate "Anonymous DAX: shared mappings backed by private memory"
	depends on DEV_DAX && NUMA && MMU
	depends on MEMORY_HOTPLUG && MEMORY_HOTREMOVE
	help
	  Bind a device-dax instance to anondax to online its ranges as a
	  private memory node.  MAP_SHARED mappings of the resulting device
	  allocate pages explicitly from that node; MAP_PRIVATE is rejected.

	  Each open file describes an independent allocation object.  Mappings
	  of the same offsets through that file share their contents.
	  The private node always permits reclaim and compaction.

	  Say N if unsure.

config DEV_DAX_CRAM
	tristate "CRAM DAX: test compressed private memory"
	depends on DEV_DAX && CRAM
	depends on MEMORY_HOTPLUG && MEMORY_HOTREMOVE
	help
	  Provide an explicit device-dax mode for exercising the CRAM
	  compressed-memory service.  The driver onlines the device ranges as
	  private movable memory and exposes test controls for CRAM provider
	  events such as capacity changes and allocation withdrawal.

	  This is a test provider.  It does not emulate compression hardware.
	  Its trim callback zeros pages in place.

	  Say N if unsure.
endif
```
